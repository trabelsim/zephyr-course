## CMakeLists.txt
```
cmake_minimum_required(VERSION 3.20.0)

list(APPEND BOARD_ROOT ${CMAKE_CURRENT_SOURCE_DIR}/..)
list(APPEND EXTRA_ZEPHYR_MODULES ${CMAKE_CURRENT_SOURCE_DIR}/../my-driver-module)
find_package(Zephyr REQUIRED)
project(my_zephyr_app)

target_sources(app PRIVATE src/main.cpp)
```

## Kconfig
```
menuconfig LED_SUBSYSTEM 
    bool "LED Subsystem"
    default y

if LED_SUBSYSTEM

choice
    prompt "LED blink sleep time"
    default BLINK_SLEEP_1000MS

config BLINK_SLEEP_250MS
    bool "Very fast"

config BLINK_SLEEP_500MS
    bool "Fast"

config BLINK_SLEEP_1000MS
    bool "Normal"

config BLINK_SLEEP_2000MS
    bool "Slow"

endchoice

menuconfig ADVANCED_LED_SUBSYSTEM
    bool "Advanced LED settings"

if ADVANCED_LED_SUBSYSTEM

config LED_BRIGHTNESS
    int "LED brightness (0-100)"
    range 0 100
    default 100

config LED_FADE_DURATION
    int "LED fade duration (ms)"
    range 0 5000
    default 500

menu "Expert settings"
    visible if ADVANCED_LED_SUBSYSTEM

config LED_DEBUG
    bool "Enable LED debugging"

config CUSTOM_BLINK_PATTERN
    bool "Custom blink pattern"

endmenu

endif #ADVANCED_LED_SUBSYSTEM
endif #LED_SUBSYSTEM


config BLINK_SLEEP_TIME_MS
    int # As long as there is no prompt -> this is hidden.
    default 250 if BLINK_SLEEP_250MS
    default 500 if BLINK_SLEEP_500MS
    default 1000 if BLINK_SLEEP_1000MS
    default 2000 if BLINK_SLEEP_2000MS
    range 100 5000
    help
        help
            string can be multiline
            Like this one.

config APP_HEARTBEAT_PERIOD_MS
    int "Heartbeat period (ms)"
    default 500
    range 100 2000


source "Kconfig.zephyr"
```

## prj.conf
```kconfig
CONFIG_GPIO=y
CONFIG_LOG=y
CONFIG_MY_DRIVER=y
```

## app.overlay
```dts
/ {
    aliases {
        app-led = &led0;
        app-led-2 = &led1;
    };

    my_driver0: my_driver {
        compatible = "my,led-sensor";
        led = <&led1>;
        status = "okay";
    };
};
```

## boards/our_board.overlay
```dts
/ {
    aliases {
        app-led = &blue_led_1;
    };
};
```

## src/main.cpp
```c
#include <zephyr/drivers/gpio.h>
#include <zephyr/kernel.h>
#include <zephyr/logging/log.h>
#include <zephyr/drivers/sensor.h>
#include "my_driver_api.h"

LOG_MODULE_REGISTER(main, LOG_LEVEL_INF);

const struct device* my_dev = DEVICE_DT_GET(DT_NODELABEL(my_driver0));

int main(void)
{
    if (!device_is_ready(my_dev)) {
        LOG_ERR("My driver device not ready");
        return 0;
    }

    if (!IS_ENABLED(CONFIG_LED_SUBSYSTEM))
    {
        LOG_INF("Led subsystem not activated. Please activate in menuconfig. Exiting.");
        return 0;
    }

    int sleep_ms = CONFIG_APP_HEARTBEAT_PERIOD_MS;
    LOG_INF("LED Subsystem set time: %ld", sleep_ms);

    while (1) 
    {
        sensor_sample_fetch(my_dev);
        my_driver_inc_blink_count(my_dev);
        k_msleep(sleep_ms);

        struct sensor_value val;
        sensor_channel_get(my_dev, SENSOR_CHAN_ALL, &val);

        int count = my_driver_get_blink_count(my_dev);
        LOG_INF("Blink count: %d", count);
        
        k_msleep(sleep_ms);
    }

    return 0;
}
```
