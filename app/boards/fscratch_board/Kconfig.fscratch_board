## app/boards/fscratch_board/fscratch_board_defconfig
```kconfig
# Enable UART driver
CONFIG_SERIAL=y

# Enable GPIO
CONFIG_GPIO=y

# Enable clock
CONFIG_CLOCK_CONTROL=y

# Console
CONFIG_CONSOLE=y
CONFIG_UART_CONSOLE=y
```

## app/boards/our_board/board.yml
```yaml
board:
  name: our_board
  full_name: Our board
  vendor: MT
  socs:
    - name: stm32wba65xx
      variants:
        - name: ns
```

## boards/fscratch_board/board.yml
```yaml
board:
  name: fscratch_board
  full_name: F-Scratch board
  vendor: MT
  socs:
    - name: stm32wba65xx
```

## boards/our_board/Kconfig
```kconfig
# Copyright (c) 2025 STMicroelectronics
# SPDX-License-Identifier: Apache-2.0

config BOARD_OUR_BOARD
	select BOARD_LATE_INIT_HOOK
```

## boards/our_board/Kconfig.defconfig
```kconfig
# STM32WBA65RI Nucleo board configuration

# Copyright (c) 2025 STMicroelectronics

# SPDX-License-Identifier: Apache-2.0

if BOARD_OUR_BOARD

config SPI_STM32_INTERRUPT
	default y
	depends on SPI

endif # BOARD_OUR_BOARD
```

## my-driver-module/dts/bindings/my,led-sensor.yaml
```yaml
description: My custom led sensor driver
compatible: my,led-sensor
include: base.yaml
properties:
  led:
    type: phandle
    required: true
    description: Reference to an existing LED node
  initial-state:
    type: boolean
    required: false
    description: Initial state of the LED (on/off)
```
